/*
 * Copyright (c) 2020 Pete Johanson
 *
 * SPDX-License-Identifier: MIT
 */

#include "dolphin.dtsi"

&default_transform {
	col-offset = <8>;
};

&kscan0 {
  row-gpios
    = <&pro_micro 18 (GPIO_ACTIVE_HIGH | GPIO_PULL_DOWN)>  // Top Row 0
    , <&pro_micro 15 (GPIO_ACTIVE_HIGH | GPIO_PULL_DOWN)>  // Row 1
    , <&pro_micro 14 (GPIO_ACTIVE_HIGH | GPIO_PULL_DOWN)>  // Row 2
    , <&pro_micro 16 (GPIO_ACTIVE_HIGH | GPIO_PULL_DOWN)>  // Row 3
    , <&pro_micro 20 (GPIO_ACTIVE_HIGH | GPIO_PULL_DOWN)>  // Row 4
    ;
	col-gpios
		= <&pro_micro 10 GPIO_ACTIVE_HIGH>  // Most right/Outter Column 0
		= <&pro_micro 19 GPIO_ACTIVE_HIGH>  // Column 1
		, <&pro_micro 0 GPIO_ACTIVE_HIGH>   // Column 2
		, <&pro_micro 2 GPIO_ACTIVE_HIGH>   // Column 3
		, <&pro_micro 3 GPIO_ACTIVE_HIGH>   // Column 4
		, <&pro_micro 4 GPIO_ACTIVE_HIGH>   // Column 5
		, <&pro_micro 6 GPIO_ACTIVE_HIGH>   // Column 6
		, <&pro_micro 5 GPIO_ACTIVE_HIGH>   // Column 7
		;
};
