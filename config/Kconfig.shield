## config/Kconfig.shield
```kconfig
# Copyright (c) 2020 Pete Johanson
# SPDX-License-Identifier: MIT

config SHIELD_DOLPHIN_LEFT
    def_bool $(shields_list_contains,dolphin_left)

config SHIELD_DOLPHIN_RIGHT
    def_bool $(shields_list_contains,dolphin_right)
```
